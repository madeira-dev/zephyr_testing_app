## west.yml
```yaml
# The manifest below uses releases (tags) instead of branch
# manifest:
#   remotes:
#     - name: zephyrproject-rtos
#       url-base: https://github.com/zephyrproject-rtos
#   projects:
#     - name: zephyr
#       remote: zephyrproject-rtos
#       revision: main
#       import: true

#     # Add your library here!
#     - name: hello-zephyr-library # This is the local directory name west will create
#       path: modules/lib/hello_lib # Where west will place it
#       url: https://github.com/madeira-dev/hello_zephyr_library.git
#       revision: v1.0.2 # Use the tag you created
#   self:
#     path: app # The application code is in the 'app' directory

# The branch below uses branch (main branch called zephyr)
manifest:
  remotes:
    - name: zephyrproject-rtos
      url-base: https://github.com/zephyrproject-rtos
  projects:
    - name: zephyr
      remote: zephyrproject-rtos
      revision: main
      import: true

    # Add your library here!
    - name: hello-zephyr-library # This is the local directory name west will create
      path: modules/lib/hello_lib # Where west will place it
      url: https://github.com/madeira-dev/hello_zephyr_library.git
      revision: zephyr
  self:
    path: app # The application code is in the 'app' directory
```
