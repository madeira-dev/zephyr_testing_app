## CMakeLists.txt
```
cmake_minimum_required(VERSION 3.20)

# 1. Load your embedded OpenFHE module
list(APPEND ZEPHYR_EXTRA_MODULES ${CMAKE_CURRENT_LIST_DIR}/../../hello_lib)

# 2. Initialize Zephyr
find_package(Zephyr REQUIRED HINTS $ENV{ZEPHYR_BASE})

# 3. Define Project
project(app LANGUAGES C CXX)

# 4. Add Sources
target_sources(app PRIVATE src/initial_test.cpp)
```

## prj.conf
```kconfig
# Enable lib
CONFIG_HELLO_LIB=y

# Core C++ Support
CONFIG_CPP=y
CONFIG_STD_CPP17=y
CONFIG_NEWLIB_LIBC=y
CONFIG_REQUIRES_FULL_LIBCPP=y
CONFIG_PICOLIBC=n
CONFIG_PICOLIBC_USE_MODULE=n

CONFIG_CPP_EXCEPTIONS=y
CONFIG_CPP_RTTI=y

# Memory Configuration
CONFIG_HEAP_MEM_POOL_SIZE=4096

# mainly for openfhe recursiveness
CONFIG_MAIN_STACK_SIZE=8192

# Randomness
# Without this, the PRNG returns 0s, crashing ModInverse/KeyGen
CONFIG_ENTROPY_GENERATOR=y
# Test RNG for emulators (Renode)
CONFIG_TEST_RANDOM_GENERATOR=y

# Disable Boot Banner (saves a tiny bit of RAM)
CONFIG_BOOT_BANNER=n

# strictly output only (saves tiny RAM too)
CONFIG_SHELL=n
CONFIG_CONSOLE=y
CONFIG_UART_CONSOLE=y

# Optimization flags
CONFIG_SIZE_OPTIMIZATIONS=y
CONFIG_NO_OPTIMIZATIONS=n
CONFIG_DEBUG_OPTIMIZATIONS=n

# Strip unused sections (Aggressive dead code removal)
CONFIG_LINKER_ORPHAN_SECTION_WARN=n

# Logging & Debugging
CONFIG_LOG=n
CONFIG_LOG_MODE_MINIMAL=n
```

## src/main.c
```c
#include <zephyr/kernel.h>
#include <zephyr/logging/log.h>
#include "openfhe_embedded.h"
#include <string.h>

LOG_MODULE_REGISTER(test_fhe_lib, LOG_LEVEL_INF);

// Define test parameters
#define TEST_RING_DIMENSION 256
#define TEST_SCALING_FACTOR 4096.0

int main(void)
{
  LOG_INF("--- Starting OpenFHE-Embedded Library Test ---");

  static fhe_context_t context;
  memset(&context, 0, sizeof(fhe_context_t));

  // ========================================================================
  // 1. Test FHE Context Initialization
  // ========================================================================
  LOG_INF("1. Testing FHE Context Initialization...");
  LOG_INF("   Ring Dimension: %u, Scaling Factor: %.1f", TEST_RING_DIMENSION, TEST_SCALING_FACTOR);

  uint64_t start_cycles = math_hal_get_cycles();
  int ret = fhe_context_init(&context, TEST_RING_DIMENSION, TEST_SCALING_FACTOR);
  uint64_t end_cycles = math_hal_get_cycles();

  if (ret == 0 && context.is_initialized)
  {
    LOG_INF("   SUCCESS: Context initialized in %llu cycles.", (end_cycles - start_cycles));
    LOG_INF("   - CryptoParams: %u moduli generated.", context.params.num_moduli);
    LOG_INF("   - Public Key: Generated successfully.");
  }
  else
  {
    LOG_ERR("   FAILURE: Context initialization failed with code %d.", ret);
    return -1;
  }

  // ========================================================================
  // 2. Test CKKS Encryption
  // ========================================================================
  LOG_INF("2. Testing CKKS Encryption...");
  double sample_data[] = {0.1, 0.2, 0.3, 0.4};
  size_t sample_count = sizeof(sample_data) / sizeof(double);

  printk("   Plaintext to encrypt (%d values): [", sample_count);
  for (size_t i = 0; i < sample_count; i++)
  {
    printk("%.2f%s", sample_data[i], (i == sample_count - 1) ? "" : ", ");
  }
  printk("]\n");

  static ckks_ciphertext_t ciphertext;
  start_cycles = math_hal_get_cycles();
  ret = fhe_encrypt(&context, sample_data, sample_count, &ciphertext);
  end_cycles = math_hal_get_cycles();

  if (ret == 0)
  {
    LOG_INF("   SUCCESS: Encryption completed in %llu cycles.", (end_cycles - start_cycles));
    LOG_INF("   - Ciphertext scaling factor: %.1f (Expected: %.1f)", ciphertext.scaling_factor, TEST_SCALING_FACTOR);
    LOG_INF("   - Ciphertext level: %u (Expected: 0)", ciphertext.level);
  }
  else
  {
    LOG_ERR("   FAILURE: Encryption failed with code %d.", ret);
    fhe_context_cleanup(&context);
    return -1;
  }

  // ========================================================================
  // 4. Test Context Cleanup
  // ========================================================================
  LOG_INF("4. Testing Context Cleanup...");
  fhe_context_cleanup(&context);
  if (!context.is_initialized)
  {
    LOG_INF("   SUCCESS: Context cleaned up successfully.");
  }
  else
  {
    LOG_ERR("   FAILURE: Context cleanup failed.");
  }

  LOG_INF("--- All tests complete ---");

  return 0;
}
```

## src/initial_test.cpp
```c
#include <zephyr/kernel.h>
#include <zephyr/sys/printk.h>
#include "api.h"

int main(void)
{
  test_lib();

  return 0;
}
```

## src/main_aa.c
```c
// #include <zephyr/kernel.h>
// #include <zephyr/logging/log.h>
// #include "scheme/ckks/ckks_cryptoparams.h"
// #include "core/math/biginteger.h"
// #include <string.h>
// #include <stdbool.h>
// #include <stdio.h>

// LOG_MODULE_REGISTER(test_ckks_cryptoparams);

// static int tests_passed = 0;
// static int tests_failed = 0;

// static void test_report_assert(const char *name, bool passed, const char *details)
// {
//     if (passed)
//     {
//         tests_passed++;
//         LOG_INF("[PASS] %s", name);
//     }
//     else
//     {
//         tests_failed++;
//         LOG_ERR("[FAIL] %s: %s", name, details);
//     }
// }

// static void assert_eq_u32(const char *name, uint32_t expected, uint32_t actual)
// {
//     char details[64];
//     if (expected != actual)
//     {
//         snprintf(details, sizeof(details), "expected=%u actual=%u", expected, actual);
//         test_report_assert(name, false, details);
//     }
//     else
//     {
//         test_report_assert(name, true, "");
//     }
// }

// static void assert_eq_double(const char *name, double expected, double actual, double tol)
// {
//     char details[64];
//     if (!(fabs(expected - actual) <= tol))
//     {
//         snprintf(details, sizeof(details), "expected=%g actual=%g tol=%g", expected, actual, tol);
//         test_report_assert(name, false, details);
//     }
//     else
//     {
//         test_report_assert(name, true, "");
//     }
// }

// static void assert_eq_str(const char *name, const char *expected, const char *actual)
// {
//     char details[128];
//     if (strcmp(expected, actual) != 0)
//     {
//         snprintf(details, sizeof(details), "expected=\"%s\" actual=\"%s\"", expected, actual);
//         test_report_assert(name, false, details);
//     }
//     else
//     {
//         test_report_assert(name, true, "");
//     }
// }

// int main(void)
// {
//     ckks_cryptoparams_t params;
//     bigint_t moduli[CKKS_MAX_MODULI];

//     // Initialize modulus chain with small values for testing
//     for (uint32_t i = 0; i < CKKS_MAX_MODULI; i++)
//     {
//         bigint_init_u64(&moduli[i], 17 + i); // values: 17, 18 (CKKS_MAX_MODULI == 2)
//     }

//     uint32_t ring_dimension = 8;
//     double scaling_factor = 1 << 20;
//     uint32_t max_depth = 2;
//     uint32_t num_moduli = 2;

//     int ret = ckks_cryptoparams_init(&params, ring_dimension, moduli, num_moduli, scaling_factor, max_depth);
//     if (ret != 0)
//     {
//         LOG_ERR("ckks_cryptoparams_init failed!");
//         return -1;
//     }

//     // Basic value assertions
//     assert_eq_u32("ring_dimension", ring_dimension, params.ring_dimension);
//     assert_eq_u32("num_moduli", num_moduli, params.num_moduli);
//     assert_eq_u32("max_depth", max_depth, params.max_depth);
//     assert_eq_double("scaling_factor", scaling_factor, params.scaling_factor, 1e-9);

//     // Check modulus chain strings against expected values
//     const char *expected_mods[CKKS_MAX_MODULI] = {"17", "18"};
//     char buf[64];
//     for (uint32_t i = 0; i < num_moduli; i++)
//     {
//         bigint_to_string(&params.modulus_chain[i], buf, sizeof(buf));
//         char name[32];
//         snprintf(name, sizeof(name), "modulus[%u]", i);
//         assert_eq_str(name, expected_mods[i], buf);

//         // Also log the modulus and bits for visibility
//         LOG_INF("Modulus %u: %s (bits: %u)", i, buf, params.modulus_bits[i]);
//     }

//     // Sanity check for polynomial params that should mirror ring_dimension and modulus bits
//     assert_eq_u32("poly_params.ring_dimension", params.poly_params.ring_dimension, params.ring_dimension);
//     assert_eq_u32("poly_params.modulus_bits", params.poly_params.modulus_bits, params.modulus_bits[0]);

//     // Cleanup
//     ckks_cryptoparams_cleanup(&params);

//     // Summary
//     LOG_INF("Tests passed: %d, failed: %d", tests_passed, tests_failed);
//     if (tests_failed > 0)
//     {
//         LOG_ERR("One or more tests failed");
//         return -1;
//     }

//     LOG_INF("All basic tests passed");
//     return 0;
// }
```

## src/main_encoder_test.c
```c
// #include <stdio.h>
// #include <zephyr/logging/log.h>
// #include "scheme/ckks/ckks_encoder.h"
// #include "scheme/ckks/ckks_cryptoparams.h"
// #include "core/math/polynomial.h"
// #include "core/math/biginteger.h"

// LOG_MODULE_REGISTER(test_ckks_encoder, LOG_LEVEL_DBG);

// void print_poly(const polynomial_t *poly)
// {
//     LOG_INF("Polynomial degree: %u", poly->degree);
//     for (uint32_t i = 0; i <= poly->degree; i++)
//     {
//         char buf[32];
//         bigint_to_string(&poly->coeffs[i], buf, sizeof(buf));
//         LOG_INF("Coeff[%u] = %s", i, buf);
//     }
// }

// int main(void)
// {
//     // 1. Setup modulus chain
//     static bigint_t modulus_chain[1];
//     bigint_init_u64(&modulus_chain[0], 65537); // Example small prime modulus

//     // 2. Setup CKKS crypto params
//     static ckks_cryptoparams_t params;
//     ckks_cryptoparams_init(&params, 8, modulus_chain, 1, 1 << 20, 1);

//     // 3. Setup encoder
//     static ckks_encoder_t encoder;
//     ckks_encoder_init(&encoder, &params);

//     // 4. Input values
//     double values[4] = {1.5, -2.0, 3.25, 0.0};

//     // 5. Output polynomial
//     static polynomial_t poly;
//     ckks_encode(&encoder, values, 4, &poly);

//     // 6. Print result
//     print_poly(&poly);

//     return 0;
// }
```

## src/main_math_test.c
```c
// #include <zephyr/kernel.h>
// #include <zephyr/logging/log.h>

// // Include the external hello_lib header
// #include "core/lattice/element.h"
// #include "core/lattice/ring_element.h"
// #include "core/math/biginteger.h"
// #include "core/math/math_hal.h"
// #include "core/math/polynomial.h"

// // Define a logging module for this test app (different name to avoid conflicts)
// LOG_MODULE_REGISTER(test_app, LOG_LEVEL_DBG);

// // Test functions for math components
// static void test_bigint_basic(void)
// {
//     LOG_INF("=== Testing BigInteger Basic Operations ===");

//     bigint_t a, b, result;

//     // Initialize
//     bigint_init(&a);
//     bigint_init(&b);
//     bigint_init(&result);

//     // Test initialization with values
//     bigint_init_u64(&a, 12345);
//     bigint_init_u64(&b, 6789);

//     LOG_INF("a initialized to 12345");
//     LOG_INF("b initialized to 6789");

//     // Test basic operations
//     if (bigint_add(&result, &a, &b) == 0)
//     {
//         LOG_INF("Addition test: a + b = %u (expected ~19134)",
//                 (uint32_t)result.words[0]);
//     }
//     else
//     {
//         LOG_ERR("Addition test failed");
//     }

//     if (bigint_mult(&result, &a, &b) == 0)
//     {
//         LOG_INF("Multiplication test: a * b = %llu (expected ~83810205)",
//                 ((uint64_t)result.words[1] << 32) | result.words[0]);
//     }
//     else
//     {
//         LOG_ERR("Multiplication test failed");
//     }

//     // Test comparison
//     if (bigint_compare(&a, &b) > 0)
//     {
//         LOG_INF("Comparison test: a > b (correct)");
//     }
//     else
//     {
//         LOG_INF("Comparison test: a <= b");
//     }

//     LOG_INF("BigInteger basic tests completed");
// }

// static void test_polynomial_basic(void)
// {
//     LOG_INF("=== Testing Polynomial Basic Operations ===");

//     static polynomial_t poly_a, poly_b, poly_result;
//     bigint_t coeff;

//     // Initialize polynomials
//     if (poly_init(&poly_a, 4) != 0)
//     {
//         LOG_ERR("Failed to initialize polynomial A");
//         return;
//     }

//     if (poly_init(&poly_b, 4) != 0)
//     {
//         LOG_ERR("Failed to initialize polynomial B");
//         return;
//     }

//     if (poly_init(&poly_result, 8) != 0)
//     {
//         LOG_ERR("Failed to initialize result polynomial");
//         return;
//     }

//     LOG_INF("Polynomials initialized successfully");

//     // Set some coefficients for poly_a: 3x^2 + 2x + 1
//     bigint_init_u64(&coeff, 1);
//     poly_set_coeff(&poly_a, 0, &coeff); // constant term

//     bigint_init_u64(&coeff, 2);
//     poly_set_coeff(&poly_a, 1, &coeff); // x term

//     bigint_init_u64(&coeff, 3);
//     poly_set_coeff(&poly_a, 2, &coeff); // x^2 term

//     LOG_INF("poly_a = 3x^2 + 2x + 1");

//     // Set coefficients for poly_b: 2x + 5
//     bigint_init_u64(&coeff, 5);
//     poly_set_coeff(&poly_b, 0, &coeff); // constant term

//     bigint_init_u64(&coeff, 2);
//     poly_set_coeff(&poly_b, 1, &coeff); // x term

//     LOG_INF("poly_b = 2x + 5");

//     // Test polynomial addition
//     poly_ring_params_t params;
//     params.ring_dimension = 256;
//     bigint_init_u64(&params.coefficient_modulus, 65537); // Small prime
//     params.modulus_bits = 17;

//     if (poly_add(&poly_result, &poly_a, &poly_b, &params) == 0)
//     {
//         bigint_t result_coeff;
//         poly_get_coeff(&poly_result, 0, &result_coeff);
//         LOG_INF("Addition result: constant term = %u (expected 6)",
//                 (uint32_t)result_coeff.words[0]);

//         poly_get_coeff(&poly_result, 1, &result_coeff);
//         LOG_INF("Addition result: x term = %u (expected 4)",
//                 (uint32_t)result_coeff.words[0]);

//         poly_get_coeff(&poly_result, 2, &result_coeff);
//         LOG_INF("Addition result: x^2 term = %u (expected 3)",
//                 (uint32_t)result_coeff.words[0]);
//     }
//     else
//     {
//         LOG_ERR("Polynomial addition failed");
//     }

//     // Cleanup
//     poly_cleanup(&poly_a);
//     poly_cleanup(&poly_b);
//     poly_cleanup(&poly_result);

//     LOG_INF("Polynomial basic tests completed");
// }

// static void test_math_hal_basic(void)
// {
//     LOG_INF("=== Testing Math HAL Basic Operations ===");

//     // Test modular arithmetic
//     math_word_t a = 123;
//     math_word_t b = 456;
//     math_word_t m = 1000;

//     math_word_t result = math_hal_mod_add(a, b, m);
//     LOG_INF("(%u + %u) mod %u = %u (expected 579)",
//             (uint32_t)a, (uint32_t)b, (uint32_t)m, (uint32_t)result);

//     result = math_hal_mod_mult(a, b, m);
//     LOG_INF("(%u * %u) mod %u = %u (expected 88)",
//             (uint32_t)a, (uint32_t)b, (uint32_t)m, (uint32_t)result);

//     // Test RNG initialization
//     if (math_hal_rng_init() == 0)
//     {
//         LOG_INF("RNG initialized successfully");

//         // Test random bytes generation
//         LOG_INF("About to generate random bytes");
//         uint8_t random_buffer[1];
//         if (math_hal_rng_bytes(random_buffer, sizeof(random_buffer)) == 0)
//         {
//             LOG_INF("Generated 1 random byte");
//         }
//         else
//         {
//             LOG_ERR("Failed to generate random bytes");
//         }
//     }
//     else
//     {
//         LOG_ERR("Failed to initialize RNG");
//     }

//     LOG_INF("Math HAL basic tests completed");
// }

// static void test_memory_usage(void)
// {
//     LOG_INF("=== Memory Usage Analysis ===");

//     LOG_INF("sizeof(bigint_t) = %u bytes", sizeof(bigint_t));
//     LOG_INF("sizeof(polynomial_t) = %u bytes", sizeof(polynomial_t));
//     LOG_INF("sizeof(math_word_t) = %u bytes", sizeof(math_word_t));

//     LOG_INF("POLY_MAX_DEGREE = %d", POLY_MAX_DEGREE);
//     LOG_INF("POLY_MAX_COEFFS = %d", POLY_MAX_COEFFS);
//     LOG_INF("BIGINT_MAX_WORDS = %d", BIGINT_MAX_WORDS);

//     // Calculate memory usage for common operations
//     size_t single_poly_mem = sizeof(polynomial_t);
//     size_t three_poly_mem = 3 * sizeof(polynomial_t);

//     LOG_INF("Memory for 1 polynomial: %u bytes (%.1f%% of 256KB RAM)",
//             single_poly_mem, (single_poly_mem * 100.0) / (256 * 1024));
//     LOG_INF("Memory for 3 polynomials: %u bytes (%.1f%% of 256KB RAM)",
//             three_poly_mem, (three_poly_mem * 100.0) / (256 * 1024));

//     if (three_poly_mem > (256 * 1024 / 10))
//     {
//         LOG_WRN("Memory usage is high - consider reducing POLY_MAX_DEGREE");
//     }
// }

// int main(void)
// {
//     LOG_INF("=== OpenFHE Embedded Math Library Tests ===");
//     LOG_INF("Target: nRF52840DK (ARM Cortex-M4F, 256KB RAM)");

//     // Run memory analysis first
//     test_memory_usage();

//     // Run basic math tests
//     test_math_hal_basic();
//     test_bigint_basic();
//     test_polynomial_basic();

//     LOG_INF("=== All Math Tests Completed ===");

//     // Wait to allow logs to flush (important for Renode/Zephyr)
//     // k_sleep(K_MSEC(3000));

//     return 0;
// }
```

## src/main_math_tests.c
```c
#include <zephyr/kernel.h>
#include <zephyr/logging/log.h>

// Include the external hello_lib header
#include "core/lattice/element.h"
#include "core/lattice/ring_element.h"
#include "core/math/biginteger.h"
#include "core/math/math_hal.h"
#include "core/math/polynomial.h"

// Define a logging module for this test app (different name to avoid conflicts)
LOG_MODULE_REGISTER(test_app, LOG_LEVEL_DBG);

// Test functions for math components
static void test_bigint_basic(void)
{
    LOG_INF("=== Testing BigInteger Basic Operations ===");

    bigint_t a, b, result;

    // Initialize
    bigint_init(&a);
    bigint_init(&b);
    bigint_init(&result);

    // Test initialization with values
    bigint_init_u64(&a, 12345);
    bigint_init_u64(&b, 6789);

    LOG_INF("a initialized to 12345");
    LOG_INF("b initialized to 6789");

    // Test basic operations
    if (bigint_add(&result, &a, &b) == 0)
    {
        LOG_INF("Addition test: a + b = %u (expected ~19134)",
                (uint32_t)result.words[0]);
    }
    else
    {
        LOG_ERR("Addition test failed");
    }

    if (bigint_mult(&result, &a, &b) == 0)
    {
        LOG_INF("Multiplication test: a * b = %llu (expected ~83810205)",
                ((uint64_t)result.words[1] << 32) | result.words[0]);
    }
    else
    {
        LOG_ERR("Multiplication test failed");
    }

    // Test comparison
    if (bigint_compare(&a, &b) > 0)
    {
        LOG_INF("Comparison test: a > b (correct)");
    }
    else
    {
        LOG_INF("Comparison test: a <= b");
    }

    LOG_INF("BigInteger basic tests completed");
}

static void test_polynomial_basic(void)
{
    LOG_INF("=== Testing Polynomial Basic Operations ===");

    static polynomial_t poly_a, poly_b, poly_result;
    bigint_t coeff;

    // Initialize polynomials
    if (poly_init(&poly_a, 4) != 0)
    {
        LOG_ERR("Failed to initialize polynomial A");
        return;
    }

    if (poly_init(&poly_b, 4) != 0)
    {
        LOG_ERR("Failed to initialize polynomial B");
        return;
    }

    if (poly_init(&poly_result, 8) != 0)
    {
        LOG_ERR("Failed to initialize result polynomial");
        return;
    }

    LOG_INF("Polynomials initialized successfully");

    // Set some coefficients for poly_a: 3x^2 + 2x + 1
    bigint_init_u64(&coeff, 1);
    poly_set_coeff(&poly_a, 0, &coeff); // constant term

    bigint_init_u64(&coeff, 2);
    poly_set_coeff(&poly_a, 1, &coeff); // x term

    bigint_init_u64(&coeff, 3);
    poly_set_coeff(&poly_a, 2, &coeff); // x^2 term

    LOG_INF("poly_a = 3x^2 + 2x + 1");

    // Set coefficients for poly_b: 2x + 5
    bigint_init_u64(&coeff, 5);
    poly_set_coeff(&poly_b, 0, &coeff); // constant term

    bigint_init_u64(&coeff, 2);
    poly_set_coeff(&poly_b, 1, &coeff); // x term

    LOG_INF("poly_b = 2x + 5");

    // Test polynomial addition
    poly_ring_params_t params;
    params.ring_dimension = 256;
    bigint_init_u64(&params.coefficient_modulus, 65537); // Small prime
    params.modulus_bits = 17;

    if (poly_add(&poly_result, &poly_a, &poly_b, &params) == 0)
    {
        bigint_t result_coeff;
        poly_get_coeff(&poly_result, 0, &result_coeff);
        LOG_INF("Addition result: constant term = %u (expected 6)",
                (uint32_t)result_coeff.words[0]);

        poly_get_coeff(&poly_result, 1, &result_coeff);
        LOG_INF("Addition result: x term = %u (expected 4)",
                (uint32_t)result_coeff.words[0]);

        poly_get_coeff(&poly_result, 2, &result_coeff);
        LOG_INF("Addition result: x^2 term = %u (expected 3)",
                (uint32_t)result_coeff.words[0]);
    }
    else
    {
        LOG_ERR("Polynomial addition failed");
    }

    // Cleanup
    poly_cleanup(&poly_a);
    poly_cleanup(&poly_b);
    poly_cleanup(&poly_result);

    LOG_INF("Polynomial basic tests completed");
}

static void test_math_hal_basic(void)
{
    LOG_INF("=== Testing Math HAL Basic Operations ===");

    // Test modular arithmetic
    math_word_t a = 123;
    math_word_t b = 456;
    math_word_t m = 1000;

    math_word_t result = math_hal_mod_add(a, b, m);
    LOG_INF("(%u + %u) mod %u = %u (expected 579)",
            (uint32_t)a, (uint32_t)b, (uint32_t)m, (uint32_t)result);

    result = math_hal_mod_mult(a, b, m);
    LOG_INF("(%u * %u) mod %u = %u (expected 88)",
            (uint32_t)a, (uint32_t)b, (uint32_t)m, (uint32_t)result);

    // Test RNG initialization
    if (math_hal_rng_init() == 0)
    {
        LOG_INF("RNG initialized successfully");

        // Test random bytes generation
        LOG_INF("About to generate random bytes");
        uint8_t random_buffer[1];
        if (math_hal_rng_bytes(random_buffer, sizeof(random_buffer)) == 0)
        {
            LOG_INF("Generated 1 random byte");
        }
        else
        {
            LOG_ERR("Failed to generate random bytes");
        }
    }
    else
    {
        LOG_ERR("Failed to initialize RNG");
    }

    LOG_INF("Math HAL basic tests completed");
}

static void test_memory_usage(void)
{
    LOG_INF("=== Memory Usage Analysis ===");

    LOG_INF("sizeof(bigint_t) = %u bytes", sizeof(bigint_t));
    LOG_INF("sizeof(polynomial_t) = %u bytes", sizeof(polynomial_t));
    LOG_INF("sizeof(math_word_t) = %u bytes", sizeof(math_word_t));

    LOG_INF("POLY_MAX_DEGREE = %d", POLY_MAX_DEGREE);
    LOG_INF("POLY_MAX_COEFFS = %d", POLY_MAX_COEFFS);
    LOG_INF("BIGINT_MAX_WORDS = %d", BIGINT_MAX_WORDS);

    // Calculate memory usage for common operations
    size_t single_poly_mem = sizeof(polynomial_t);
    size_t three_poly_mem = 3 * sizeof(polynomial_t);

    LOG_INF("Memory for 1 polynomial: %u bytes (%.1f%% of 256KB RAM)",
            single_poly_mem, (single_poly_mem * 100.0) / (256 * 1024));
    LOG_INF("Memory for 3 polynomials: %u bytes (%.1f%% of 256KB RAM)",
            three_poly_mem, (three_poly_mem * 100.0) / (256 * 1024));

    if (three_poly_mem > (256 * 1024 / 10))
    {
        LOG_WRN("Memory usage is high - consider reducing POLY_MAX_DEGREE");
    }
}

int main(void)
{
    LOG_INF("=== OpenFHE Embedded Math Library Tests ===");
    LOG_INF("Target: nRF52840DK (ARM Cortex-M4F, 256KB RAM)");

    // Run memory analysis first
    test_memory_usage();

    // Run basic math tests
    test_math_hal_basic();
    test_bigint_basic();
    test_polynomial_basic();

    LOG_INF("=== All Math Tests Completed ===");

    // Wait to allow logs to flush (important for Renode/Zephyr)
    // k_sleep(K_MSEC(3000));

    return 0;
}
```

## src/test_ckks_params.c
```c
#include <zephyr/kernel.h>
#include <zephyr/ztest.h>
#include <stdint.h>
#include <stdbool.h>

#include "openfhe_embedded.h"
#include "internal/ckks_params.h"

static void fill_minimal_params_2048(oe_ckks_params_t *p)
{
  memset(p, 0, sizeof(*p));
  p->ring_dim = 2048;
  p->num_q = 0;
  p->scale = 0.0;
  p->ntt_mode = OE_NTT_ON_THE_FLY;
  p->ifft_mode = OE_IFFT_ON_THE_FLY;
  p->mempool_hint_bytes = 0;
}

static const uint32_t kPreset_q[3] = {
    998244353u,
    1004535809u,
    469762049u};

/* Test ckks_params_get_preset_2048() */
ZTEST(ckks_params_suite, test_get_preset_2048_valid)
{
  oe_ckks_params_t params;
  fill_minimal_params_2048(&params);

  oe_status_t status = ckks_params_get_preset_2048(&params);
  zassert_equal(status, OE_OK, "Preset function should succeed");

  zassert_true(params.num_q > 0 && params.num_q <= OE_MAX_LIMBS, "num_q invalid");
  zassert_true(params.scale > 0.0, "scale should be positive");

  for (uint32_t i = 0; i < params.num_q; i++)
  {
    zassert_true(ckks_qi_is_ntt_friendly(params.q[i], params.ring_dim),
                 "Prime q[%u] not NTT-friendly: %u", i, params.q[i]);
  }

  if (params.num_q == 3)
  {
    for (uint32_t i = 0; i < 3; i++)
    {
      zassert_equal(params.q[i], kPreset_q[i], "Preset prime mismatch at index %u", i);
    }
  }
}

ZTEST(ckks_params_suite, test_get_preset_2048_invalid_ring_dim)
{
  oe_ckks_params_t params;
  fill_minimal_params_2048(&params);
  params.ring_dim = 4096; /* invalid for this preset */

  oe_status_t status = ckks_params_get_preset_2048(&params);
  zassert_equal(status, OE_ERR_INVALID_ARG, "Should reject wrong ring_dim");
}

ZTEST(ckks_params_suite, test_get_preset_2048_non_power_of_two_ring_dim)
{
  oe_ckks_params_t params;
  fill_minimal_params_2048(&params);
  params.ring_dim = 3000; /* not power of two */

  oe_status_t status = ckks_params_get_preset_2048(&params);
  zassert_equal(status, OE_ERR_INVALID_ARG, "Should reject non-power-of-two ring_dim");
}

/* Test ckks_params_validate() */
ZTEST(ckks_params_suite, test_validate_valid_preset)
{
  oe_ckks_params_t params;
  fill_minimal_params_2048(&params);
  ckks_params_get_preset_2048(&params);

  oe_status_t status = ckks_params_validate(&params);
  zassert_equal(status, OE_OK, "Validation should pass on valid preset");
}

ZTEST(ckks_params_suite, test_validate_invalid_ring_dim)
{
  oe_ckks_params_t params;
  fill_minimal_params_2048(&params);
  ckks_params_get_preset_2048(&params);

  params.ring_dim = 1234; /* not power of two */
  oe_status_t status = ckks_params_validate(&params);
  zassert_equal(status, OE_ERR_INVALID_ARG, "Validation should fail for invalid ring_dim");
}

ZTEST(ckks_params_suite, test_validate_num_q_zero_and_overflow)
{
  oe_ckks_params_t params;
  fill_minimal_params_2048(&params);
  ckks_params_get_preset_2048(&params);

  params.num_q = 0;
  zassert_equal(ckks_params_validate(&params), OE_ERR_INVALID_ARG, "num_q=0 should fail");

  params.num_q = OE_MAX_LIMBS + 1;
  zassert_equal(ckks_params_validate(&params), OE_ERR_INVALID_ARG, "num_q overflow should fail");
}

ZTEST(ckks_params_suite, test_validate_invalid_q_values)
{
  oe_ckks_params_t params;
  fill_minimal_params_2048(&params);
  ckks_params_get_preset_2048(&params);

  uint32_t saved = params.q[0];

  /* qi == 0 */
  params.q[0] = 0;
  zassert_equal(ckks_params_validate(&params), OE_ERR_INVALID_ARG, "qi=0 should fail");

  /* qi >= 2^OE_Q_MAX_BITS */
  params.q[0] = (1u << OE_Q_MAX_BITS);
  zassert_equal(ckks_params_validate(&params), OE_ERR_INVALID_ARG, "qi too large should fail");

  /* qi not congruent to 1 mod 2N */
  params.q[0] = saved + 2;
  zassert_equal(ckks_params_validate(&params), OE_ERR_INVALID_ARG, "qi not 1 mod 2N should fail");

  params.q[0] = saved;
}

ZTEST(ckks_params_suite, test_validate_nonpositive_scale)
{
  oe_ckks_params_t params;
  fill_minimal_params_2048(&params);
  ckks_params_get_preset_2048(&params);

  params.scale = 0.0;
  zassert_equal(ckks_params_validate(&params), OE_ERR_INVALID_ARG, "scale=0 should fail");

  params.scale = -1.0;
  zassert_equal(ckks_params_validate(&params), OE_ERR_INVALID_ARG, "scale<0 should fail");
}

ZTEST(ckks_params_suite, test_validate_invalid_modes)
{
  oe_ckks_params_t params;
  fill_minimal_params_2048(&params);
  ckks_params_get_preset_2048(&params);

  params.ntt_mode = (oe_ntt_mode_t)999;
  zassert_equal(ckks_params_validate(&params), OE_ERR_INVALID_ARG, "Invalid ntt_mode should fail");
  params.ntt_mode = OE_NTT_ON_THE_FLY;

  params.ifft_mode = (oe_ifft_mode_t)888;
  zassert_equal(ckks_params_validate(&params), OE_ERR_INVALID_ARG, "Invalid ifft_mode should fail");
}

/* Test ckks_qi_is_ntt_friendly() */
ZTEST(ckks_params_suite, test_qi_is_ntt_friendly_true)
{
  for (size_t i = 0; i < 3; i++)
  {
    zassert_true(ckks_qi_is_ntt_friendly(kPreset_q[i], 2048), "Preset prime should be NTT friendly");
  }
}

ZTEST(ckks_params_suite, test_qi_is_ntt_friendly_false)
{
  /* Not 1 mod 2N */
  zassert_false(ckks_qi_is_ntt_friendly(998244354u, 2048), "Prime not 1 mod 2N should be false");

  /* N not power of two */
  zassert_false(ckks_qi_is_ntt_friendly(998244353u, 3000), "N not power of two should be false");

  /* qi too large */
  uint32_t large = (1u << OE_Q_MAX_BITS);
  zassert_false(ckks_qi_is_ntt_friendly(large, 2048), "qi too large should be false");
}

/* Test ckks_params_derive() */
ZTEST(ckks_params_suite, test_derive_valid)
{
  oe_ckks_params_t params;
  fill_minimal_params_2048(&params);
  ckks_params_get_preset_2048(&params);
  zassert_equal(ckks_params_validate(&params), OE_OK, "Params should validate");

  oe_derived_consts_t derived;
  memset(&derived, 0, sizeof(derived));

  oe_status_t status = ckks_params_derive(&params, &derived);
  zassert_equal(status, OE_OK, "Derive should succeed");

  zassert_equal(derived.ring_dim, params.ring_dim, "Derived ring_dim mismatch");
  zassert_equal(derived.twoN, params.ring_dim * 2, "Derived twoN mismatch");
  zassert_equal(derived.num_q, params.num_q, "Derived num_q mismatch");

  for (uint32_t i = 0; i < derived.num_q; i++)
  {
    uint32_t q = derived.primes[i].q;
    uint32_t ninv = derived.primes[i].n_inv_mod_q;
    zassert_equal(q, params.q[i], "Prime q mismatch at index %u", i);
    zassert_not_equal(ninv, 0u, "n_inv_mod_q should be nonzero");

    uint32_t lhs = (uint32_t)(((uint64_t)(params.ring_dim % q) * (uint64_t)ninv) % (uint64_t)q);
    zassert_equal(lhs, 1u, "n_inv_mod_q is not inverse mod q");

    uint64_t mu = derived.primes[i].barrett_mu;
    zassert_true(mu >= (UINT64_C(1) << 32), "barrett_mu too small");
    zassert_true(mu <= UINT64_MAX / q, "barrett_mu * q overflow");
  }
}

ZTEST(ckks_params_suite, test_derive_invalid_q)
{
  oe_ckks_params_t params;
  fill_minimal_params_2048(&params);
  ckks_params_get_preset_2048(&params);

  uint32_t saved = params.q[0];
  params.q[0] = saved + 2; /* break congruence */

  oe_derived_consts_t derived;
  memset(&derived, 0, sizeof(derived));

  oe_status_t status = ckks_params_derive(&params, &derived);
  zassert_equal(status, OE_ERR_INVALID_ARG, "Derive should fail for invalid q");

  params.q[0] = saved;
}

/* Test ckks_params_estimate_ntt_plan_bytes() */
ZTEST(ckks_params_suite, test_estimate_ntt_plan_bytes_precomputed)
{
  oe_ckks_params_t params;
  fill_minimal_params_2048(&params);
  ckks_params_get_preset_2048(&params);

  size_t expected = params.num_q * (2 * params.ring_dim * 4 + 32);
  size_t est = ckks_params_estimate_ntt_plan_bytes(params.ring_dim, params.num_q, params.q, OE_NTT_PRECOMPUTED);
  zassert_equal(est, expected, "Unexpected NTT plan bytes estimate");
}

ZTEST(ckks_params_suite, test_estimate_ntt_plan_bytes_on_the_fly_and_invalid)
{
  oe_ckks_params_t params;
  fill_minimal_params_2048(&params);
  ckks_params_get_preset_2048(&params);

  size_t est = ckks_params_estimate_ntt_plan_bytes(params.ring_dim, params.num_q, params.q, OE_NTT_ON_THE_FLY);
  zassert_equal(est, 0, "Estimate should be zero for ON_THE_FLY mode");

  est = ckks_params_estimate_ntt_plan_bytes(0, params.num_q, params.q, OE_NTT_PRECOMPUTED);
  zassert_equal(est, 0, "Estimate zero for ring_dim=0");

  est = ckks_params_estimate_ntt_plan_bytes(params.ring_dim, 0, params.q, OE_NTT_PRECOMPUTED);
  zassert_equal(est, 0, "Estimate zero for num_q=0");

  est = ckks_params_estimate_ntt_plan_bytes(params.ring_dim, params.num_q, NULL, OE_NTT_PRECOMPUTED);
  zassert_equal(est, 0, "Estimate zero for NULL q array");
}

/* Test ckks_params_estimate_ifft_plan_bytes() */
ZTEST(ckks_params_suite, test_estimate_ifft_plan_bytes_precomputed)
{
  size_t est = ckks_params_estimate_ifft_plan_bytes(2048, OE_IFFT_PRECOMPUTED);
  size_t expected = 2048 * 18 + 32;
  zassert_equal(est, expected, "Unexpected IFFT plan bytes estimate");
}

ZTEST(ckks_params_suite, test_estimate_ifft_plan_bytes_on_the_fly_and_invalid)
{
  size_t est = ckks_params_estimate_ifft_plan_bytes(2048, OE_IFFT_ON_THE_FLY);
  zassert_equal(est, 0, "Estimate zero for ON_THE_FLY mode");

  est = ckks_params_estimate_ifft_plan_bytes(0, OE_IFFT_PRECOMPUTED);
  zassert_equal(est, 0, "Estimate zero for ring_dim=0");

  est = ckks_params_estimate_ifft_plan_bytes(3000, OE_IFFT_PRECOMPUTED);
  zassert_equal(est, 0, "Estimate zero for non-power-of-two ring_dim");
}

/* Register test suite */
ZTEST_SUITE(ckks_params_suite, NULL, NULL, NULL, NULL, NULL);
```

## src/test_encode.c
```c
#include <zephyr/kernel.h>
#include <zephyr/ztest.h>
#include <stdint.h>
#include <stdbool.h>
#include <stdlib.h>
#include <string.h>
#include <math.h>

#include "openfhe_embedded.h"
#include "internal/encode.h"
#include "internal/ckks_params.h" /* only for OE_MAX_LIMBS / consistency; not strictly required */

/* ---------- Small helpers ---------- */

static uint32_t log2_u32(uint32_t n)
{
  uint32_t bits = 0;
  while (n > 1)
  {
    n >>= 1u;
    bits++;
  }
  return bits;
}

/* Bit-reversal (same definition as in encode.c’s build_bitrev) */
static uint16_t bitrev_of(uint16_t x, uint32_t bits)
{
  uint16_t r = 0;
  for (uint32_t b = 0; b < bits; ++b)
  {
    r = (uint16_t)((r << 1) | (x & 1u));
    x >>= 1u;
  }
  return r;
}

/* ---------- Requirements & exact size ---------- */

ZTEST(encode_suite, test_requirements_on_the_fly)
{
  size_t hint = 1234;
  zassert_equal(encode_plan_requirements(2048, OE_IFFT_ON_THE_FLY, &hint), OE_OK, "ON_THE_FLY req failed");
  zassert_equal(hint, 0, "ON_THE_FLY hint must be 0");

  size_t exact = encode_plan_exact_bytes(2048, OE_IFFT_ON_THE_FLY);
  zassert_equal(exact, 0, "ON_THE_FLY exact must be 0");
}

ZTEST(encode_suite, test_requirements_precomputed_valid)
{
  const uint32_t N = 2048;
  size_t hint = 0;
  zassert_equal(encode_plan_requirements(N, OE_IFFT_PRECOMPUTED, &hint), OE_OK, "PRE req failed");
  zassert_true(hint > 0, "hint must be > 0");

  size_t exact = encode_plan_exact_bytes(N, OE_IFFT_PRECOMPUTED);
  zassert_true(exact > 0, "exact must be > 0");
  zassert_equal(exact, hint, "exact != hint");
}

ZTEST(encode_suite, test_requirements_precomputed_invalid_args)
{
  size_t hint = 0;

  /* null out_size_hint */
  zassert_equal(encode_plan_requirements(2048, OE_IFFT_PRECOMPUTED, NULL),
                OE_ERR_INVALID_ARG, "should reject NULL out_size_hint");

  /* non power-of-two N */
  zassert_equal(encode_plan_requirements(3000, OE_IFFT_PRECOMPUTED, &hint),
                OE_ERR_INVALID_ARG, "should reject non-power-of-two N");

  /* ring_dim==0 */
  zassert_equal(encode_plan_requirements(0, OE_IFFT_PRECOMPUTED, &hint),
                OE_ERR_INVALID_ARG, "should reject N=0");
}

ZTEST(encode_suite, test_exact_bytes_invalid_mode_and_inputs)
{
  zassert_equal(encode_plan_exact_bytes(2048, (oe_ifft_mode_t)999), 0, "invalid mode must return 0");
  zassert_equal(encode_plan_exact_bytes(0, OE_IFFT_PRECOMPUTED), 0, "N=0 must return 0");
  zassert_equal(encode_plan_exact_bytes(3000, OE_IFFT_PRECOMPUTED), 0, "non power-of-two must return 0");
}

/* ---------- Plan init / free and accessors ---------- */

ZTEST(encode_suite, test_plan_init_on_the_fly_and_accessors)
{
  oe_encode_plan_t *plan = NULL;
  zassert_equal(encode_plan_init(0 /* unused in OTF */, OE_IFFT_ON_THE_FLY,
                                 NULL, 0, &plan),
                OE_OK, "init OTF failed");
  zassert_not_null(plan, "plan is NULL");
  zassert_equal(encode_plan_mode(plan), OE_IFFT_ON_THE_FLY, "mode mismatch");

  /* Accessors: OTF => no twiddles/perm present */
  size_t len = 999;
  zassert_is_null(encode_plan_get_twiddles(plan, &len), "twiddles must be NULL in OTF");
  zassert_equal(len, 0, "twiddles len must be 0 in OTF");
  zassert_is_null(encode_plan_get_bitrev(plan, &len), "bitrev must be NULL in OTF");
  zassert_equal(len, 0, "bitrev len must be 0 in OTF");

  /* ring_dim accessor returns what was set in the plan; for OTF we put 0 */
  zassert_equal(encode_plan_ring_dim(plan), 0u, "ring_dim accessor mismatch in OTF");

  encode_plan_free(plan);
}

ZTEST(encode_suite, test_plan_init_precomputed_and_accessors)
{
  const uint32_t N = 2048;
  zassert_true(is_power_of_two(N), "test requires power of two N");

  size_t bytes = encode_plan_exact_bytes(N, OE_IFFT_PRECOMPUTED);
  zassert_true(bytes > 0, "exact bytes must be > 0");

  void *pool = malloc(bytes);
  zassert_not_null(pool, "malloc pool failed");

  oe_encode_plan_t *plan = NULL;
  zassert_equal(encode_plan_init(N, OE_IFFT_PRECOMPUTED, pool, bytes, &plan),
                OE_OK, "init PRE failed");
  zassert_not_null(plan, "plan is NULL");
  zassert_equal(encode_plan_mode(plan), OE_IFFT_PRECOMPUTED, "mode mismatch");
  zassert_equal(encode_plan_ring_dim(plan), N, "ring_dim accessor mismatch");

  /* Twiddles: expect 2*N doubles; Bitrev: N uint16_t */
  size_t tw_len = 0, br_len = 0;
  const double *tw = encode_plan_get_twiddles(plan, &tw_len);
  const uint16_t *br = encode_plan_get_bitrev(plan, &br_len);

  zassert_not_null(tw, "twiddles is NULL");
  zassert_equal(tw_len, (size_t)2 * (size_t)N, "twiddles length mismatch");
  zassert_not_null(br, "bitrev is NULL");
  zassert_equal(br_len, (size_t)N, "bitrev length mismatch");

  /* Twiddle spot checks: k=0 -> (1,0); k=N/4 -> (0,-1); k=N/2 -> (-1,0) */
  const double eps = 1e-12;
  /* k=0 */
  zassert_true(fabs(tw[0] - 1.0) <= eps, "tw[0].Re != 1");
  zassert_true(fabs(tw[1] - 0.0) <= eps, "tw[0].Im != 0");
  /* k=N/4 -> angle = -2π * (N/4)/N = -π/2 */
  zassert_true(fabs(tw[2 * (N / 4) + 0] - 0.0) <= 1e-9, "tw[N/4].Re != 0");
  zassert_true(fabs(tw[2 * (N / 4) + 1] + 1.0) <= 1e-9, "tw[N/4].Im != -1");
  /* k=N/2 -> angle = -π */
  zassert_true(fabs(tw[2 * (N / 2) + 0] + 1.0) <= 1e-12, "tw[N/2].Re != -1");
  zassert_true(fabs(tw[2 * (N / 2) + 1] - 0.0) <= 1e-12, "tw[N/2].Im != 0");

  /* Bit-reversal sanity: br[br[i]] == i */
  const uint32_t bits = log2_u32(N);
  for (uint32_t i = 0; i < N; ++i)
  {
    uint16_t r = br[i];
    zassert_equal(br[r], (uint16_t)i, "bitrev involution failure at i=%u", i);
    /* also matches local bitrev function */
    zassert_equal(r, bitrev_of((uint16_t)i, bits), "bitrev value mismatch at i=%u", i);
  }

  encode_plan_free(plan);
  free(pool);
}

ZTEST(encode_suite, test_plan_init_precomputed_insufficient_pool)
{
  const uint32_t N = 2048;
  zassert_true(is_power_of_two(N), "test requires power of two N");

  /* Compute a hard lower bound that ignores alignment and metadata cushion:
     minimal = 2*N*sizeof(double) + N*sizeof(uint16_t)
     Passing (minimal - 1) must fail regardless of base alignment. */
  size_t minimal = (size_t)2 * (size_t)N * sizeof(double) +
                   (size_t)N * sizeof(uint16_t);
  zassert_true(minimal > 0, "minimal must be > 0");

  void *pool = malloc(minimal - 1);
  zassert_not_null(pool, "malloc pool failed");

  oe_encode_plan_t *plan = NULL;
  zassert_equal(encode_plan_init(N, OE_IFFT_PRECOMPUTED, pool, minimal - 1, &plan),
                OE_ERR_INVALID_ARG, "init should fail with insufficient pool");
  zassert_is_null(plan, "plan should remain NULL");

  free(pool);
}

/* ---------- Register test suite ---------- */
ZTEST_SUITE(encode_suite, NULL, NULL, NULL, NULL, NULL);
```
